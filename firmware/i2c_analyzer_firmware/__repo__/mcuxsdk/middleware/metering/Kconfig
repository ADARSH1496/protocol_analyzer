## firmware/i2c_analyzer_firmware/__repo__/mcuxsdk/middleware/metering/Kconfig
```kconfig
menu "Metering"
	# meterlib (MMAU)
    config MCUX_COMPONENT_middleware.metering.meterlib
        bool "meterlib"
        select MCUX_COMPONENT_middleware.metering.fraclib
        help
            Middleware metering meterlib.

	# meterliblp (MMAU)
    config MCUX_COMPONENT_middleware.metering.meterliblp
        bool "meterliblp"
        select MCUX_COMPONENT_middleware.metering.fraclib
        help
            Middleware metering meterliblp.

	# meterfft (MMAU)
    config MCUX_COMPONENT_middleware.metering.meterfft
        bool "meterfft"
        select MCUX_COMPONENT_middleware.metering.fraclib
        help
            Middleware metering meterfft.

	# fraclib (MMAU)
    config MCUX_COMPONENT_middleware.metering.fraclib
        bool "fraclib"
        help
            Middleware metering fraclib.

	# meterlib (no MMAU)
    config MCUX_COMPONENT_middleware.metering.meterlib_no_mmau
        bool "meterlib (no MMAU)"
        select MCUX_COMPONENT_middleware.metering.fraclib_no_mmau
        help
            Middleware metering meterlib (no MMAU).

	# meterliblp (no MMAU)
    config MCUX_COMPONENT_middleware.metering.meterliblp_no_mmau
        bool "meterliblp (no MMAU)"
        select MCUX_COMPONENT_middleware.metering.fraclib_no_mmau
        help
            Middleware metering meterliblp (no MMAU).

	# meterfft (no MMAU)
    config MCUX_COMPONENT_middleware.metering.meterfft_no_mmau
        bool "meterfft (no MMAU)"
        select MCUX_COMPONENT_middleware.metering.fraclib_no_mmau
        help
            Middleware metering meterfft (no MMAU).
			
	# fraclib (no MMAU)
    config MCUX_COMPONENT_middleware.metering.fraclib_no_mmau
        bool "fraclib (no MMAU)"
        help
            Middleware metering fraclib (no MMAU).

endmenu
```
